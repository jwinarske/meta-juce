## conf/layer.conf
```bitbake
# We have a conf and classes directory, append to BBPATH
BBPATH .= ":${LAYERDIR}"

BBFILES += "${LAYERDIR}/recipes*/*/*.bb ${LAYERDIR}/recipes*/*/*.bbappend ${LAYERDIR}/images/*.bb"

BBFILE_COLLECTIONS += "meta-juce"
BBFILE_PATTERN_meta-juce := "^${LAYERDIR}/"
BBFILE_PRIORITY_meta-juce = "12"

LAYERSERIES_COMPAT_meta-juce = "zeus"
```
